#include "config.h"

#include <WEMOS_Matrix_LED.h>

#ifdef MATRIX_LED

#define LED_MAX_X (8)
#define LED_MAX_Y (8)

#define DISPLAY_STRING_DELAY (500)

MLED mled(5); //set intensity=5

char font_num[10][8] = { 
                    { 0x07, 0x05, 0x05, 0x05, 0x05, 0x05, 0x05, 0x07 }, // 0
                    { 0x02, 0x06, 0x02, 0x02, 0x02, 0x02, 0x02, 0x07 }, // 1
                    { 0x07, 0x01, 0x01, 0x07, 0x04, 0x04, 0x04, 0x07 }, // 2
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                    { 0x07, 0x05, 0x05, 0x07, 0x01, 0x01, 0x01, 0x01 }, // 9
};

char font_alpha[26][8] = {
                    { 0x06, 0x09, 0x09, 0x0F, 0x09, 0x09, 0x09, 0x09 }, // A
                    { 0x0E, 0x09, 0x09, 0x0E, 0x09, 0x09, 0x09, 0x0E }, // B
                    { 0x06, 0x09, 0x09, 0x08, 0x08, 0x08, 0x09, 0x06 }, // C
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                    { 0x0F, 0x01, 0x01, 0x02, 0x04, 0x08, 0x08, 0x0F }, // Z

};

char font_SPChar[26][8] = {
                    { 0x00, 0x00, 0x00, 0x00, 0x00, 0x00, 0x00, 0x00 }, // Space
                    { 0x06, 0x06, 0x06, 0x06, 0x06, 0x00, 0x06, 0x06 }, // !
                    { 0x05, 0x05, 0x00, 0x00, 0x00, 0x00, 0x00, 0x00 }, // "
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                    { 0x01, 0x01, 0x02, 0x02, 0x02, 0x04, 0x04, 0x04 }, // /
};



int isAlpha(char ch)
{
  if ((ch >= 'A' && ch <= 'Z') || (ch >= 'a' && ch <= 'z') )
    return 1;
  else 
    return 0;
}

int isNum(char ch)
{
  if( ch >= '0' && ch <= '9')
    return 1;
  else 
    return 0;
}

int isSPChar(char ch)
{
  if( ch >= ' ' && ch <= '/')
    return 1;
  else 
    return 0;
}

char toUpper(char ch)
{
  if (ch >= 'a' && ch <= 'z')
    return ch - 'a' + 'A';
  else 
    return ch;
}

void LedSetup()
{
  // put your setup code here, to run once:
  mled.intensity=5;

  LedDisplayClear();
}

void LedDisplayString(char *string)
{
  char ch;
  int i;

  for(i = 0; (ch = *(string+i)) != '\0'; i++) {
    Serial.println(ch);
    if( isAlpha(ch) ) {
      ch = toUpper(ch);
      LedDisplayAlpha(ch, 0);
    } else if( isNum(ch) ) {
      LedDisplayNum(ch - '0', 0);
    } else if( isSPChar(ch) )
      LedDisplaySPChar(ch, 0);

    delay(DISPLAY_STRING_DELAY);
  }
}

void LedDisplayStringScroll(char *string)
{
  char ch;
  int i;
  int led_digit = 4;  // right 4 digits

  for(i = 0; (ch = *(string+i)) != '\0'; i++) {
    Serial.print(i); Serial.println(ch);
    if( isAlpha(ch) ) {
      ch = toUpper(ch);
      LedDisplayAlpha(ch, led_digit);
    } else if( isNum(ch) ) {
      LedDisplayNum(ch - '0', led_digit);
    } else if( isSPChar(ch) )
      LedDisplaySPChar(ch, led_digit);

    delay(DISPLAY_STRING_DELAY);
    LedDisplayBufferScroll();
  }
 
}

void LedDisplayBufferScroll(void)
{
  int x, y;
  
  for(y = 0; y < 8; y++) {
    mled.disBuffer[y] >>= 4;
  }
  mled.display();
}


void LedDisplayNum(int num, int digit)
{
  int tmp_num = num;
  tmp_num %= 10; // only 2 digits
  
  LedDisplayFont((font_num[tmp_num % 10]), digit, 0, 1);  
}

void LedDisplayAlpha(char alpha, int digit)
{
  int tmp_num;
  tmp_num = alpha - 'A';
  
  LedDisplayFont((font_alpha[tmp_num]), digit, 0, 1);
}

void LedDisplaySPChar(char spc, int digit)
{
  int tmp_num;
  tmp_num = spc - ' ';
  
  LedDisplayFont((font_SPChar[tmp_num]), digit, 0, 1);
}

void LedDisplayFont(char font[], int x, int y, int sc)
{
  int ix, iy;
  
//  Serial.print("Sizeof(font) : "); Serial.print(sizeof(font));
  
  for(iy = 0; iy < 8; iy++) {
//    Serial.println(font[iy], HEX);
    for( ix = 0; ix < 4; ix++) {
      if( sc ) {
#ifdef LED_UPSIDEDOWN
        mled.dot((LED_MAX_X-1-x)-ix, iy, font[iy] & (0x01 << (3-ix)) ); // LEX_MAX_X : 8
#else
        mled.dot(ix+x, (LED_MAX_Y-1-y)-iy, font[iy] & (0x01 << (3-ix)) ); // LEX_MAX_X : 8
#endif
      } else {
#ifdef LED_UPSIDEDOWN
        mled.dot((LED_MAX_X-1-x)-ix, iy, 0 );
#else
        mled.dot(ix+x, (LED_MAX_Y-1-y)-iy, 0 );
#endif
      }
      mled.display();
    }
  }
}

void LedDisplayScan()
{

  for(int y=0;y<8;y++)
  {
    for(int x=0;x<8;x++)
    {
        mled.dot(x,y); // draw dot
        mled.display();
        delay(10);
        mled.dot(x,y,0);//clear dot
        mled.display();
        delay(10);        
    }  
  }
}

void LedDisplayClear()
{

  for(int y=0;y<8;y++)
  {
    for(int x=0;x<8;x++)
    {
        mled.dot(x,y,0);//clear dot
        mled.display();
    }  
  }
}
#endif
